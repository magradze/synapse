## components/modules/storage/storage_manager/Kconfig
```kconfig
menu "Storage Manager"

    config MODULE_STORAGE_MANAGER_ENABLED
        bool "Enable Storage Manager Module"
        default y
        help
            Enables the Storage Manager module for centralized data persistence.
            This module provides a unified API for various storage backends like
            NVS, SPIFFS, and SD Cards.

    if MODULE_STORAGE_MANAGER_ENABLED

        # --- General Configuration ---
        config STORAGE_MANAGER_DEFAULT_INSTANCE_NAME
            string "Default Instance Name"
            default "main_storage"
            help
                Default instance name for the Storage Manager service registration.

        config STORAGE_MANAGER_INSTANCE_NAME_MAX_LEN
            int "Maximum Instance Name Length"
            default 32
            range 8 64
            help
                Maximum buffer size for the module's instance name string.

        # --- Backend Selection ---
        choice STORAGE_MANAGER_BACKEND
            prompt "Storage Backend"
            default STORAGE_BACKEND_NVS
            help
                Select the primary storage backend for the Storage Manager service.
                - NVS: Best for small key-value configuration data.
                - SPIFFS: A simple filesystem on the internal flash, good for web assets or logs.
                - SD_CARD: For large files and high-capacity storage, requires an SD card.

            config STORAGE_BACKEND_NVS
                bool "NVS (Non-Volatile Storage)"

            config STORAGE_BACKEND_SPIFFS
                bool "SPIFFS Filesystem"

            config STORAGE_BACKEND_SD_CARD
                bool "SD Card"
        endchoice

         # --- SPIFFS Specific Configuration ---
        menu "SPIFFS Configuration"
            depends on STORAGE_BACKEND_SPIFFS

            # ★★★ შესწორება: დაემატა MOUNT_POINT SPIFFS-ისთვის ★★★
            config STORAGE_SPIFFS_MOUNT_POINT
                string "SPIFFS Mount Point"
                default "/spiffs"
                help
                    The virtual filesystem (VFS) path where the SPIFFS partition will be mounted.

            config STORAGE_SPIFFS_PARTITION_LABEL
                string "SPIFFS Partition Label"
                default "spiffs"
                help
                    The label of the SPIFFS partition as defined in your partition table.

            config STORAGE_SPIFFS_MAX_FILES
                int "Maximum open files"
                default 5
                help
                    The maximum number of files that can be open simultaneously.

            config STORAGE_SPIFFS_FORMAT_IF_MOUNT_FAILED
                bool "Format if mount fails"
                default y
                help
                    If enabled, the SPIFFS partition will be formatted if it cannot be mounted.
                    This is useful for initial setup but may cause data loss on a corrupted partition.

        endmenu # SPIFFS Configuration

        # --- SD Card Specific Configuration ---
        menu "SD Card Configuration"
            depends on STORAGE_BACKEND_SD_CARD

            config STORAGE_SD_CARD_MOUNT_POINT
                string "SD Card Mount Point"
                default "/sdcard"
                help
                    The virtual filesystem (VFS) path where the SD card will be mounted.

            choice STORAGE_SD_INTERFACE
                prompt "SD Card Interface"
                default STORAGE_SD_INTERFACE_SPI
                help
                    Select the communication protocol for the SD card.

                config STORAGE_SD_INTERFACE_SPI
                    bool "SPI"

                config STORAGE_SD_INTERFACE_SDMMC
                    bool "SDMMC (1-bit or 4-bit)"
            endchoice

            # --- SPI Interface Settings ---
            if STORAGE_SD_INTERFACE_SPI

                config STORAGE_SD_SPI_HOST
                    int "SPI Host"
                    default 1 # VSPI_HOST
                    range 1 2
                    help
                        Select the SPI host peripheral to use (e.g., 1 for VSPI, 2 for HSPI).

                config STORAGE_SD_PIN_MISO
                    int "MISO Pin"
                    default 19
                    help
                        GPIO pin number for the MISO (Master In, Slave Out) signal.

                config STORAGE_SD_PIN_MOSI
                    int "MOSI Pin"
                    default 23
                    help
                        GPIO pin number for the MOSI (Master Out, Slave In) signal.

                config STORAGE_SD_PIN_CLK
                    int "CLK Pin"
                    default 18
                    help
                        GPIO pin number for the SCLK (Serial Clock) signal.

                config STORAGE_SD_PIN_CS
                    int "CS Pin"
                    default 5
                    help
                        GPIO pin number for the CS (Chip Select) signal.

            endif # STORAGE_SD_INTERFACE_SPI

            # --- SDMMC Interface Settings (for future expansion) ---
            if STORAGE_SD_INTERFACE_SDMMC
                # Here you would add configs for SDMMC pins (CMD, CLK, D0, D1, D2, D3)
                # This is left as an example for future implementation.
                config STORAGE_SD_SDMMC_UNSUPPORTED
                    bool "SDMMC is not yet fully configured in this Kconfig"
                    default y
            endif # STORAGE_SD_INTERFACE_SDMMC

        endmenu # SD Card Configuration

    endif # MODULE_STORAGE_MANAGER_ENABLED

endmenu
```

## components/modules/system/alarms_manager/Kconfig
```kconfig
menu "Alarms Manager"

    config MODULE_ALARMS_MANAGER_ENABLED
        bool "Enable Alarms Manager Module"
        default y
        help
            Enables the Alarms Manager module. This module provides a centralized,
            rule-based system for reacting to critical framework events.

    # --- General Configuration ---
    # ეს სექცია უკვე არსებობდა, ვტოვებთ უცვლელად
    config ALARMS_MANAGER_DEFAULT_INSTANCE_NAME
        string "Default Instance Name"
        default "main_alarms_manager"
        depends on MODULE_ALARMS_MANAGER_ENABLED
        help
            Default instance name for the alarms_manager module.

    config ALARMS_MANAGER_INSTANCE_NAME_MAX_LEN
        int "Maximum Instance Name Length"
        default 32
        range 8 64
        depends on MODULE_ALARMS_MANAGER_ENABLED
        help
            Maximum length for the alarms_manager module instance name string.

    # --- Resource and Buffer Configuration ---
    # ★★★ აქედან იწყება ახალი, დამატებული პარამეტრები ★★★
    menu "Resource and Buffer Sizing"
        depends on MODULE_ALARMS_MANAGER_ENABLED

        config ALARMS_MANAGER_MAX_RULES
            int "Maximum number of alarm rules"
            default 10
            range 1 32
            help
                Defines the maximum number of alarm rules that can be configured
                in system_config.json. This directly affects the static memory
                usage of the module.

        config ALARMS_MANAGER_MAX_ACTIONS_PER_RULE
            int "Maximum number of actions per alarm rule"
            default 5
            range 1 10
            help
                Defines the maximum number of actions that can be specified for a
                single alarm rule.

        config ALARMS_MANAGER_MAX_EVENT_NAME_LEN
            int "Maximum length for event names"
            default 32
            range 16 64
            help
                Buffer size for storing event names specified in alarm rules.

        config ALARMS_MANAGER_MAX_CONDITION_KEY_LEN
            int "Maximum length for condition keys"
            default 32
            range 16 64
            help
                Buffer size for storing the 'condition_payload_key' string from
                the alarm rule configuration.

        config ALARMS_MANAGER_MAX_CONDITION_VALUE_LEN
            int "Maximum length for condition values"
            default 32
            range 16 64
            help
                Buffer size for storing the 'condition_payload_value' string from
                the alarm rule configuration.

        config ALARMS_MANAGER_MAX_LOG_MESSAGE_LEN
            int "Maximum length for log messages in actions"
            default 128
            range 32 256
            help
                Buffer size for storing the 'message' string for 'log_critical' actions.

    endmenu # End of Resource and Buffer Sizing

endmenu # End of Alarms Manager
```

## components/modules/system/connectivity_watchdog/Kconfig
```kconfig
menu "Connectivity Watchdog"

    config MODULE_CONNECTIVITY_WATCHDOG_ENABLED
        bool "Enable Connectivity Watchdog Module"
        default y
        help
            Enables the connectivity_watchdog module for monitoring network and service connectivity.

    config CONNECTIVITY_WATCHDOG_DEFAULT_INSTANCE_NAME
        string "Default Instance Name"
        default "main_conn_watchdog"
        depends on MODULE_CONNECTIVITY_WATCHDOG_ENABLED
        help
            Default instance name for the connectivity_watchdog module.

    config CONNECTIVITY_WATCHDOG_INSTANCE_NAME_MAX_LEN
        int "Maximum Instance Name Length"
        default 32
        range 8 64
        depends on MODULE_CONNECTIVITY_WATCHDOG_ENABLED
        help
            Maximum length for the connectivity_watchdog module instance name string.

    config CONNECTIVITY_WATCHDOG_GRACE_PERIOD_SEC
        int "Grace Period (seconds)"
        default 30
        depends on MODULE_CONNECTIVITY_WATCHDOG_ENABLED
        help
            The initial period after startup (in seconds) during which the watchdog is inactive.

    config CONNECTIVITY_WATCHDOG_CHECK_INTERVAL_SEC
        int "Check Interval (seconds)"
        default 60
        depends on MODULE_CONNECTIVITY_WATCHDOG_ENABLED
        help
            The interval (in seconds) at which the watchdog performs its connectivity checks.

    config CONNECTIVITY_WATCHDOG_MAX_CHECKS
        int "Maximum Monitored Checks"
        default 4
        range 1 10
        depends on MODULE_CONNECTIVITY_WATCHDOG_ENABLED
        help
            The maximum number of different connectivity checks (e.g., MQTT, PING).

    config CONNECTIVITY_WATCHDOG_MAX_ACTIONS_PER_CHECK
        int "Maximum Actions per Check"
        default 5
        range 1 10
        depends on MODULE_CONNECTIVITY_WATCHDOG_ENABLED
        help
            The maximum number of recovery actions that can be defined for a single check.

endmenu
```

## components/modules/system/device_identity_service/Kconfig
```kconfig
menu "Device Identity Service"

    config MODULE_DEVICE_IDENTITY_SERVICE_ENABLED
        bool "Enable Device Identity Service Module"
        default y
        help
            Enables the Device Identity Service. This module provides a centralized
            service to retrieve unique device identifiers (like MAC address) and
            firmware version information. It is essential for cloud communication
            (e.g., MQTT Client ID) and system diagnostics.

    config DEVICE_IDENTITY_SERVICE_DEFAULT_INSTANCE_NAME
        string "Default Instance Name"
        default "main_identity_service"
        depends on MODULE_DEVICE_IDENTITY_SERVICE_ENABLED
        help
            Default instance name for the device_identity_service module.

    config DEVICE_IDENTITY_SERVICE_INSTANCE_NAME_MAX_LEN
        int "Maximum Instance Name Length"
        default 32
        range 8 64
        depends on MODULE_DEVICE_IDENTITY_SERVICE_ENABLED
        help
            Maximum length for the device_identity_service module instance name string.

endmenu
```

## components/modules/system/health_monitor/Kconfig
```kconfig
menu "Health Monitor"

    config MODULE_HEALTH_MONITOR_ENABLED
        bool "Enable Health Monitor Module"
        default y
        help
            Enables the Health Monitor module for system metrics tracking.

    if MODULE_HEALTH_MONITOR_ENABLED

        config HEALTH_MONITOR_DEFAULT_INSTANCE_NAME
            string "Default Instance Name"
            default "main_health_monitor"
            help
                Default instance name for the health monitor module.

        config HEALTH_MONITOR_INSTANCE_NAME_MAX_LEN
            int "Maximum Instance Name Length"
            default 32
            range 8 64
            help
                Maximum length for the health monitor module instance name.

        config HEALTH_MONITOR_TASK_STACK_SIZE
            int "Task Stack Size"
            default 4096
            help
                Stack size for the health monitor background task.

        config HEALTH_MONITOR_TASK_PRIORITY
            int "Task Priority"
            default 5
            range 1 24
            help
                Priority for the health monitor background task.

    endif # MODULE_HEALTH_MONITOR_ENABLED

endmenu
```

## components/modules/system/ota_update_manager/Kconfig
```kconfig
menu "Ota Update Manager"

    config MODULE_OTA_UPDATE_MANAGER_ENABLED
        bool "Enable Ota Update Manager Module"
        default y
        help
            Enables the ota_update_manager module for Handles secure Over-The-Air firmware updates.
            When enabled, the module provides full functionality.
            If disabled, the module code will not be included in 
            the final firmware, saving memory and processing resources.

    config OTA_UPDATE_MANAGER_DEFAULT_INSTANCE_NAME
        string "Default Instance Name"
        default "main_ota_update_manager"
        depends on MODULE_OTA_UPDATE_MANAGER_ENABLED
        help
            Default instance name for the ota_update_manager module.

    config OTA_UPDATE_MANAGER_INSTANCE_NAME_MAX_LEN
        int "Maximum Instance Name Length"
        default 32
        range 8 64
        depends on MODULE_OTA_UPDATE_MANAGER_ENABLED
        help
            Maximum length for the ota_update_manager module instance name string.

endmenu
```
