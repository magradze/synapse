## Kconfig.projbuild
```kconfig
# Kconfig.projbuild for Synapse Framework
# This file is included directly by ESP-IDF's menuconfig

menu "Synapse Framework"

# --- Framework Core Configuration ---
source "components/core/Kconfig"

# --- Logger Module Configuration ---
source "components/modules/utilities/logger_module/Kconfig"

# --- LED Blinker Module Configuration ---
source "components/modules/testing/led_blinker/Kconfig"

endmenu
```

## components/core/Kconfig
```kconfig
# Kconfig for Synapse Framework Core components


    menu "ბირთვის კონფიგურაცია"

        config SYNAPSE_MAX_SUBSCRIBERS_PER_EVENT
            int "მაქს. გამომწერი ერთ ივენთზე"
            default 15
            help
                განსაზღვრავს გამომწერების მაქსიმალურ რაოდენობას, რომელთა რეგისტრაციაც შესაძლებელია ერთ კონკრეტულ ივენთზე.

        config SYNAPSE_EVENT_QUEUE_LENGTH
            int "Event Bus-ის რიგის სიგრძე"
            default 50
            help
                Event Bus-ის რიგის ზომა. განსაზღვრავს, რამდენი მომლოდინე ივენთის შენახვა შეუძლია სისტემას.

        config SYNAPSE_MAX_MODULES
            int "მოდულების მაქსიმალური რაოდენობა"
            default 20
            help
                სისტემაში რეგისტრირებული მოდულების მაქსიმალური დასაშვები რაოდენობა.

        config SYNAPSE_MAX_SERVICES
            int "სერვისების მაქსიმალური რაოდენობა"
            default 32
            help
                Service Locator-ში რეგისტრირებული სერვისების მაქსიმალური დასაშვები რაოდენობა.

        config SYNAPSE_MUTEX_TIMEOUT_MS
            int "Mutex-ის ტაიმაუტი (მილიწამები)"
            default 1000
            help
                ნაგულისხმევი ტაიმაუტი მილიწამებში Mutex-ის დაკავების მცდელობისას.

        config SYNAPSE_QUEUE_TIMEOUT_MS
            int "რიგის ტაიმაუტი (მილიწამები)"
            default 100
            help
                ნაგულისხმევი ტაიმაუტი მილიწამებში რიგში მონაცემის ჩაწერის მცდელობისას.

        config SYNAPSE_SEMAPHORE_TIMEOUT_MS
            int "სემაფორის ტაიმაუტი (მილიწამები)"
            default 500
            help
                ნაგულისხმევი ტაიმაუტი მილიწამებში სემაფორის დაკავების მცდელობისას.

        config SYNAPSE_TASK_QUEUE_TIMEOUT_MS
            int "ტასკის რიგის ტაიმაუტი (მილიწამები)"
            default 1000
            help
                ნაგულისხმევი ტაიმაუტი მილიწამებში ტასკებს შორის კომუნიკაციის რიგებისთვის.

        config SYNAPSE_EVENT_BUS_TASK_STACK_SIZE
            int "Event Bus ტასკის Stack ზომა"
            default 4096
            range 2048 16384
            help
                Stack-ის ზომა ბაიტებში Event Bus-ის ფონური ტასკისთვის.

        config SYNAPSE_EVENT_BUS_TASK_PRIORITY
            int "Event Bus ტასკის პრიორიტეტი"
            default 12
            range 1 24
            help
                Event Bus-ის ფონური ტასკის პრიორიტეტი (უფრო მაღალი რიცხვი ნიშნავს მაღალ პრიორიტეტს).

        config SYNAPSE_SERVICE_NAME_MAX_LENGTH
            int "სერვისის სახელის მაქს. სიგრძე"
            default 32
            help
                სერვისის სახელის მაქსიმალური დასაშვები სიგრძე (სიმბოლოებში).

        config SYNAPSE_SERVICE_TYPE_MAX_LENGTH
            int "სერვისის ტიპის მაქს. სიგრძე"
            default 32
            help
                სერვისის ტიპის მაქსიმალური დასაშვები სიგრძე (სიმბოლოებში).

        config SYNAPSE_MODULE_NAME_MAX_LENGTH
            int "მოდულის სახელის მაქს. სიგრძე"
            default 32
            help
                მოდულის `instance_name`-ის მაქსიმალური დასაშვები სიგრძე (სიმბოლოებში).

    endmenu

    menu "ოპტიმიზაცია და მეხსიერება"

        config SYNAPSE_RUNTIME_TASK_STACK_SIZE
            int "Runtime ტასკის Stack ზომა (ოპტიმიზებული)"
            default 2048
            help
                ნაგულისხმევი Stack-ის ზომა მცირე, Runtime მოდულების ტასკებისთვის.

        config SYNAPSE_RUNTIME_QUEUE_LENGTH
            int "Runtime რიგის სიგრძე (ოპტიმიზებული)"
            default 3
            help
                ნაგულისხმევი რიგის სიგრძე მცირე, Runtime მოდულებისთვის.

        config SYNAPSE_INSTANCE_NAME_MAX_LENGTH
            int "Instance სახელის მაქს. სიგრძე (ოპტიმიზებული)"
            default 16
            help
                ოპტიმიზებული სიგრძე `instance_name`-ისთვის მეხსიერების დაზოგვის მიზნით.

        config SYNAPSE_SHARED_TASK_STACK_SIZE
            int "გაზიარებული ტასკის Stack ზომა"
            default 3072
            help
                Stack-ის ზომა იმ ტასკისთვის, რომელიც შეიძლება რამდენიმე მცირე მოდულმა გაიზიაროს.

        config SYNAPSE_NVS_KEY_MAX_LENGTH
            int "NVS გასაღების მაქს. სიგრძე"
            default 16 # NVS-ის ლიმიტია 15 + null
            range 8 16
            help
                განსაზღვრავს კონფიგურაციის გასაღების მაქსიმალურ სიგრძეს NVS-ში (null ბაიტის ჩათვლით).
                ეს უნდა ემთხვეოდეს NVS-ის მიერ დაშვებულ მაქსიმუმს (15 სიმბოლო).

    endmenu

    menu "უსაფრთხოება"

        config SYNAPSE_MQTT_COMMAND_MAX_LENGTH
            int "MQTT ბრძანების მაქს. სიგრძე"
            default 512
            help
                ბუფერის მაქსიმალური ზომა შემომავალი MQTT ბრძანებებისთვის.

        config SYNAPSE_AUTH_TOKEN_MAX_LENGTH
            int "ავთენტიფიკაციის ტოკენის მაქს. სიგრძე"
            default 64
            help
                ბუფერის მაქსიმალური ზომა ავთენტიფიკაციის ტოკენებისთვის.

        config SYNAPSE_ENABLE_MQTT_TLS
            bool "MQTT TLS მხარდაჭერა"
            default y
            help
                ჩართეთ ეს ოფცია, რათა MQTT მოდულს ჰქონდეს დაშიფრული (mqtts://) კავშირის მხარდაჭერა.
                გაითვალისწინეთ, რომ ეს ზრდის firmware-ის ზომას.

    endmenu

    menu "წარმადობის მონიტორინგი"

        config SYNAPSE_CPU_MONITORING_ENABLED
            bool "CPU მონიტორინგის ჩართვა"
            default y
            help
                ჩართავს CPU-ს დატვირთვის პერიოდულ ლოგირებას.

        config SYNAPSE_MEMORY_MONITORING_ENABLED
            bool "მეხსიერების მონიტორინგის ჩართვა"
            default y
            help
                ჩართავს თავისუფალი heap მეხსიერების პერიოდულ ლოგირებას.

        config SYNAPSE_PERFORMANCE_LOG_INTERVAL_MS
            int "მონიტორინგის ლოგის ინტერვალი (მილიწამები)"
            default 5000
            help
                წარმადობის მონიტორინგის ლოგების გამოტანის ინტერვალი მილიწამებში.

    endmenu

    menu "Resource Manager Configuration"

        config SYNAPSE_MAX_GPIO_PINS
            int "მაქსიმალური GPIO პინების რაოდენობა"
            default 40
            help
                GPIO რესურსების მაქსიმალური რაოდენობა, რომლის მართვაც შეუძლია Resource Manager-ს.

        config SYNAPSE_MAX_I2C_BUSES
            int "მაქსიმალური I2C ავტობუსების რაოდენობა"
            default 2
            help
                I2C რესურსების მაქსიმალური რაოდენობა.

        config SYNAPSE_MAX_SPI_BUSES
            int "მაქსიმალური SPI ავტობუსების რაოდენობა"
            default 2
            help
                SPI რესურსების მაქსიმალური რაოდენობა.

    endmenu

    menu "Command Router Configuration"
        config SYNAPSE_COMMAND_ROUTER_MAX_CMD_LEN
            int "Command Router-ის მაქს. ბრძანების სიგრძე"
            default 256
            help
                Command Router-ის მიერ დამუშავებული ბრძანებების მაქსიმალური სიგრძე.
                ეს განსაზღვრავს, რამდენი მონაცემის გადაცემას შეუძლია Command Router-ს ერთდროულად.
    endmenu

    menu "Promise Manager Configuration"

        config SYNAPSE_PROMISE_QUEUE_LENGTH
            int "Promise execution queue length"
            default 10
            help
                Specifies the size of the queue that holds pending promises waiting for
                their callbacks to be executed by the promise manager task.

        config SYNAPSE_PROMISE_TASK_STACK_SIZE
            int "Promise manager task stack size"
            default 3072
            range 2048 8192
            help
                Stack size in bytes for the background task that executes promise callbacks.

        config SYNAPSE_PROMISE_TASK_PRIORITY
            int "Promise manager task priority"
            default 11
            range 1 24
            help
                Priority for the promise manager's background task. It should be high
                enough to be responsive but generally lower than critical driver tasks.

    endmenu
```

## components/modules/actuators/relay_actuator/Kconfig
```kconfig
menu "Relay Actuator"

    config MODULE_RELAY_ACTUATOR_ENABLED
        bool "Enable Relay Actuator Module"
        default y
        help
            Enables the relay_actuator module for Controls a single-channel relay via GPIO..
            When enabled, the module provides full functionality.
            If disabled, the module code will not be included in 
            the final firmware, saving memory and processing resources.

    config RELAY_ACTUATOR_DEFAULT_INSTANCE_NAME
        string "Default Instance Name"
        default "main_relay_actuator"
        depends on MODULE_RELAY_ACTUATOR_ENABLED
        help
            Default instance name for the relay_actuator module.

    config RELAY_ACTUATOR_INSTANCE_NAME_MAX_LEN
        int "Maximum Instance Name Length"
        default 32
        range 8 64
        depends on MODULE_RELAY_ACTUATOR_ENABLED
        help
            Maximum length for the relay_actuator module instance name string.

    config RELAY_ACTUATOR_MAX_INSTANCES
        int "Maximum number of relay instances"
        default 5
        range 1 20
        depends on MODULE_RELAY_ACTUATOR_ENABLED
        help
            The maximum number of relay modules that can be created in the system.

endmenu
```

## components/modules/communications/mqtt_manager/Kconfig
```kconfig
menu "MQTT Manager"

    config MODULE_MQTT_MANAGER_ENABLED
        bool "Enable MQTT Manager Module"
        default y
        help
            Enables the mqtt_manager module for handling MQTT connectivity,
            forwarding remote commands, and publishing system status updates.

    if MODULE_MQTT_MANAGER_ENABLED

        config MQTT_MANAGER_DEFAULT_INSTANCE_NAME
            string "Default Instance Name"
            default "main_mqtt_manager"
            help
                Default instance name for the mqtt_manager module.

        config MQTT_MANAGER_INSTANCE_NAME_MAX_LEN
            int "Maximum Instance Name Length"
            default 32
            range 8 64
            help
                Maximum length for the mqtt_manager module instance name string.

    endif # MODULE_MQTT_MANAGER_ENABLED

endmenu
```

## components/modules/communications/wifi_manager/Kconfig
```kconfig
menu "Wifi Manager"

    config MODULE_WIFI_MANAGER_ENABLED
        bool "Enable Wifi Manager Module"
        default y
        help
            Enables the wifi_manager module for WiFi connection management.
            When enabled, the module provides full functionality.
            If disabled, the module code will not be included in 
            the final firmware, saving memory and processing resources.

    config WIFI_MANAGER_DEFAULT_INSTANCE_NAME
        string "Default Instance Name"
        default "main_wifi_manager"
        depends on MODULE_WIFI_MANAGER_ENABLED
        help
            Default instance name for the wifi_manager module.

    config WIFI_MANAGER_INSTANCE_NAME_MAX_LEN
        int "Maximum Instance Name Length"
        default 32
        range 8 64
        depends on MODULE_WIFI_MANAGER_ENABLED
        help
            Maximum length for the wifi_manager module instance name string.

    if MODULE_WIFI_MANAGER_ENABLED

        config WIFI_MANAGER_NVS_NAMESPACE
            string "NVS Namespace"
            default "wifi_creds"
            help
                NVS (Non-Volatile Storage) namespace, სადაც ინახება 
                WiFi-ს მონაცემები (SSID, პაროლი).

        config WIFI_MANAGER_NVS_SSID_KEY
            string "NVS SSID Key"
            default "ssid"
            help
                NVS გასაღები შენახული WiFi ქსელის სახელისთვის (SSID).

        config WIFI_MANAGER_NVS_PASSWORD_KEY
            string "NVS Password Key"
            default "password"
            help
                NVS გასაღები შენახული WiFi ქსელის პაროლისთვის.

        config WIFI_MANAGER_MAX_RECONNECT_ATTEMPTS
            int "ხელახლა დაკავშირების მცდელობების რაოდენობა"
            default 10
            help
                მაქსიმალური მცდელობების რაოდენობა WiFi ქსელთან 
                ხელახლა დასაკავშირებლად კავშირის დაკარგვისას.
                -1 ნიშნავს უსასრულო მცდელობას.

        config WIFI_MANAGER_RECONNECT_DELAY_MS
            int "ხელახლა დაკავშირების დაყოვნება (მილიწამები)"
            default 5000
            help
                დაყოვნების დრო მილიწამებში ორ ხელახლა დაკავშირების
                მცდელობას შორის.

    endif # MODULE_WIFI_MANAGER_ENABLED
endmenu
```

## components/modules/diagnostics/self_test_manager/Kconfig
```kconfig
menu "Self Test Manager"

    config MODULE_SELF_TEST_MANAGER_ENABLED
        bool "Enable Self Test Manager Module"
        default y
        help
            Enables the self_test_manager module for Performs system-wide self-diagnostics and health checks..
            When enabled, the module provides full functionality.
            If disabled, the module code will not be included in 
            the final firmware, saving memory and processing resources.

    config SELF_TEST_MANAGER_DEFAULT_INSTANCE_NAME
        string "Default Instance Name"
        default "main_self_test"
        depends on MODULE_SELF_TEST_MANAGER_ENABLED
        help
            Default instance name for the self_test_manager module.

    config SELF_TEST_MANAGER_INSTANCE_NAME_MAX_LEN
        int "Maximum Instance Name Length"
        default 32
        range 8 64
        depends on MODULE_SELF_TEST_MANAGER_ENABLED
        help
            Maximum length for the self_test_manager module instance name string.

    config SELF_TEST_MANAGER_TASK_STACK_SIZE
        int "Self-Test Task Stack Size"
        default 4096
        depends on MODULE_SELF_TEST_MANAGER_ENABLED
        help
            Stack size for the temporary task that runs the self-tests.

    config SELF_TEST_MANAGER_REPORT_MAX_LINES
        int "Maximum Lines in Test Report"
        default 20
        depends on MODULE_SELF_TEST_MANAGER_ENABLED
        help
            Maximum number of result lines the test report can store.

endmenu
```

## components/modules/displays/oled_display/Kconfig
```kconfig
menu "Oled_Display Module Configuration"

    config MODULE_OLED_DISPLAY_ENABLED
        bool "Enable Oled_Display Module"
        default y
        help
            Enables the oled_display module for OLED display driver.
            When enabled, the module provides full functionality.
            If disabled, the module code will not be included in 
            the final firmware, saving memory and processing resources.

    config OLED_DISPLAY_DEFAULT_INSTANCE_NAME
        string "Default Instance Name"
        default "main_oled_display"
        depends on MODULE_OLED_DISPLAY_ENABLED
        help
            Default instance name for the oled_display module.

    config OLED_DISPLAY_INSTANCE_NAME_MAX_LEN
        int "Maximum Instance Name Length"
        default 32
        range 8 64
        depends on MODULE_OLED_DISPLAY_ENABLED
        help
            Maximum length for the oled_display module instance name string.

endmenu
```
