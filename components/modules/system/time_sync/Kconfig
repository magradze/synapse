## components/modules/system/time_sync/Kconfig
```kconfig
menu "Time Sync"

    config MODULE_TIME_SYNC_ENABLED
        bool "Enable Time Sync Module"
        default y
        help
            Enables the time_sync module for Synchronizes system time using NTP/SNTP..

    config TIME_SYNC_DEFAULT_INSTANCE_NAME
        string "Default Instance Name"
        default "main_time_sync"
        depends on MODULE_TIME_SYNC_ENABLED
        help
            Default instance name for the time_sync module.

    config TIME_SYNC_INSTANCE_NAME_MAX_LEN
        int "Maximum Instance Name Length"
        default 32
        range 8 64
        depends on MODULE_TIME_SYNC_ENABLED
        help
            Maximum length for the time_sync module instance name string.

endmenu
```

## components/modules/system/watchdog_manager/Kconfig
```kconfig
menu "Watchdog Manager Module Configuration"

    config MODULE_WATCHDOG_MANAGER_ENABLED
        bool "Enable Watchdog Manager Module"
        default y
        help
            Enables the intelligent Watchdog Manager module.

    if MODULE_WATCHDOG_MANAGER_ENABLED

        config WATCHDOG_MANAGER_DEFAULT_INSTANCE_NAME
            string "Default Instance Name"
            default "main_watchdog"

        config WATCHDOG_MANAGER_INSTANCE_NAME_MAX_LEN
            int "Maximum Instance Name Length"
            default 32

        config WATCHDOG_MANAGER_TASK_STACK_SIZE
            int "Task Stack Size"
            default 3072
            help
                Stack size for the watchdog background task.

        config WATCHDOG_MANAGER_TASK_PRIORITY
            int "Task Priority"
            default 20
            range 1 24
            help
                High priority to ensure the watchdog task runs reliably.

        config WATCHDOG_MANAGER_MAX_HEARTBEAT_MODULES
            int "Max Monitored Modules"
            default 10
            range 1 20
            help
                Maximum number of modules that can register for heartbeat monitoring.

    endif # MODULE_WATCHDOG_MANAGER_ENABLED

endmenu
```

## components/modules/testing/led_blinker/Kconfig
```kconfig
menu "Led Blinker"

    config MODULE_LED_BLINKER_ENABLED
        bool "Enable Led Blinker Module"
        default y
        help
            Enables the led_blinker module for GPIO2-ზე LED-ის მარტივი ციმციმის მოდული.
            When enabled, the module provides full functionality.
            If disabled, the module code will not be included in 
            the final firmware, saving memory and processing resources.

    config LED_BLINKER_DEFAULT_INSTANCE_NAME
        string "Default Instance Name"
        default "main_led_blinker"
        depends on MODULE_LED_BLINKER_ENABLED
        help
            Default instance name for the led_blinker module.

    config LED_BLINKER_INSTANCE_NAME_MAX_LEN
        int "Maximum Instance Name Length"
        default 32
        range 8 64
        depends on MODULE_LED_BLINKER_ENABLED
        help
            Maximum length for the led_blinker module instance name string.

    config LED_BLINKER_GPIO
        int "GPIO Number for LED"
        default 2
        depends on MODULE_LED_BLINKER_ENABLED
        help
            GPIO number to which the LED is connected.

    config LED_BLINKER_INTERVAL_MS
        int "Blink Interval (ms)"
        default 500
        range 50 10000
        depends on MODULE_LED_BLINKER_ENABLED
        help
            Blinking interval in milliseconds.

endmenu
```

## components/modules/testing/sensor_simulator/Kconfig
```kconfig
menu "Sensor Simulator"

    config MODULE_SENSOR_SIMULATOR_ENABLED
        bool "Enable Sensor Simulator Module"
        default y
        help
            Enables the sensor_simulator module for Simulates sensor data for testing purposes..
            When enabled, the module provides full functionality.
            If disabled, the module code will not be included in 
            the final firmware, saving memory and processing resources.

    config SENSOR_SIMULATOR_DEFAULT_INSTANCE_NAME
        string "Default Instance Name"
        default "main_sensor_simulator"
        depends on MODULE_SENSOR_SIMULATOR_ENABLED
        help
            Default instance name for the sensor_simulator module.

    config SENSOR_SIMULATOR_INSTANCE_NAME_MAX_LEN
        int "Maximum Instance Name Length"
        default 32
        range 8 64
        depends on MODULE_SENSOR_SIMULATOR_ENABLED
        help
            Maximum length for the sensor_simulator module instance name string.

endmenu
```

## components/modules/testing/test_module/Kconfig
```kconfig
menu "Test_Module Module Configuration"

    config MODULE_TEST_MODULE_ENABLED
        bool "Enable Test_Module Module"
        default y
        help
            Enables the test_module module for ტესტირებისთვის განკუთვნილი მოდული.
            When enabled, the module provides full functionality.
            If disabled, the module code will not be included in 
            the final firmware, saving memory and processing resources.

    config TEST_MODULE_DEFAULT_INSTANCE_NAME
        string "Default Instance Name"
        default "main_test_module"
        depends on MODULE_TEST_MODULE_ENABLED
        help
            Default instance name for the test_module module.

    config TEST_MODULE_INSTANCE_NAME_MAX_LEN
        int "Maximum Instance Name Length"
        default 32
        range 8 64
        depends on MODULE_TEST_MODULE_ENABLED
        help
            Maximum length for the test_module module instance name string.

endmenu
```

## components/modules/testing/timer_test_module/Kconfig
```kconfig
menu "Timer Test Module"

    config MODULE_TIMER_TEST_ENABLED
        bool "Enable Timer Test Module"
        default y
        help
            Enables a test module to demonstrate and verify the functionality
            of the System Timer and RGB LED services.

    if MODULE_TIMER_TEST_ENABLED

        config TIMER_TEST_MODULE_DEFAULT_INSTANCE_NAME
            string "Default Instance Name"
            default "main_timer_test"
            help
                Default instance name for the Timer Test module.

        config TIMER_TEST_MODULE_INSTANCE_NAME_MAX_LEN
            int "Maximum Instance Name Length"
            default 32
            range 8 64
            help
                Maximum buffer size for the module's instance name string.

    endif # MODULE_TIMER_TEST_ENABLED

endmenu
```

## components/modules/utilities/command_router/Kconfig
```kconfig
menu "Command Router & System Shell"

    config MODULE_COMMAND_ROUTER_ENABLED
        bool "Enable Command Router Module"
        default y
        help
            Enables the command_router module for central command processing and system shell.
            When enabled, the module provides full functionality.
            If disabled, the module code will not be included in the final firmware.

    if MODULE_COMMAND_ROUTER_ENABLED

        config COMMAND_ROUTER_DEFAULT_INSTANCE_NAME
            string "Default Instance Name"
            default "main_command_router"
            help
                Default instance name for the command_router module.

        config COMMAND_ROUTER_INSTANCE_NAME_MAX_LEN
            int "Maximum Instance Name Length"
            default 32
            range 8 64
            help
                Maximum length for the command_router module instance name string.

        config COMMAND_ROUTER_ENABLE_SERIAL_SHELL
            bool "Enable Interactive Serial Shell"
            default y
            help
                If enabled, an interactive command-line interface (CLI) will be
                available on the default serial port.

        config COMMAND_ROUTER_PROMPT
            string "Serial Shell Prompt"
            default "SYNAPSE> "
            depends on COMMAND_ROUTER_ENABLE_SERIAL_SHELL
            help
                The text prompt to display in the serial shell.

        config COMMAND_ROUTER_PROMPT_MAX_LEN
            int "Maximum length for the shell prompt"
            default 24
            depends on COMMAND_ROUTER_ENABLE_SERIAL_SHELL
            help
                Sets the maximum buffer size for the serial shell prompt string.

        config COMMAND_ROUTER_MAX_COMMANDS
            int "Maximum Registered Commands"
            default 32
            range 8 128
            help
                The maximum number of commands that can be registered in the system.

        config COMMAND_ROUTER_MAX_ARGS
            int "Maximum Arguments per Command"
            default 16
            range 4 32
            help
                The maximum number of arguments (including the command itself)
                that the shell can parse.

        config COMMAND_ROUTER_MAX_CMD_LEN
            int "Maximum command string length for events"
            default 128
            help
                Maximum length of a command string passed via an event.

        config COMMAND_ROUTER_SERIAL_TASK_STACK_SIZE
            int "Serial Shell Task Stack Size"
            default 4096
            depends on COMMAND_ROUTER_ENABLE_SERIAL_SHELL
            help
                Stack size in bytes for the interactive serial shell task.

        config COMMAND_ROUTER_SERIAL_TASK_PRIORITY
            int "Serial Shell Task Priority"
            default 5
            range 1 24
            depends on COMMAND_ROUTER_ENABLE_SERIAL_SHELL
            help
                Priority for the interactive serial shell task.

    endif # MODULE_COMMAND_ROUTER_ENABLED

endmenu
```

## components/modules/utilities/logger_module/Kconfig
```kconfig
menu "Logger"

    config MODULE_LOGGER_ENABLED
        bool "Enable Logger Module"
        default y
        help
            Enables the logger module for centralized event monitoring and debugging.
            When enabled, the module captures all events from the Event Bus and 
            outputs them to the serial console. This is useful for system debugging
            and monitoring. If disabled, the module code will not be included in 
            the final firmware, saving memory and processing resources.

    config LOGGER_CONSOLE_OUTPUT_ENABLED
        bool "Enable Console Output"
        default y
        depends on MODULE_LOGGER_ENABLED
        help
            Enables console output for the logger module. When enabled, 
            all captured events will be printed to the serial console.
            Disable this to reduce console spam while keeping event 
            monitoring active.

    config LOGGER_RUNTIME_CONTROL_ENABLED
        bool "Enable Runtime Control"
        default y
        depends on MODULE_LOGGER_ENABLED
        help
            Enables runtime control of the logger module through framework 
            command events. When enabled, the module can be dynamically 
            enabled/disabled and reconfigured without restarting the system.

    config LOGGER_DEFAULT_INSTANCE_NAME
        string "Default Instance Name"
        default "main_logger"
        depends on MODULE_LOGGER_ENABLED
        help
            Default instance name for the logger module. This name is used
            to identify the module in runtime commands and configuration.

    config LOGGER_INSTANCE_NAME_MAX_LEN
        int "Maximum Instance Name Length"
        default 32
        range 8 64
        depends on MODULE_LOGGER_ENABLED
        help
            Maximum length for the logger module instance name string,
            including null terminator. Adjust based on your naming 
            requirements vs memory usage.

endmenu
```

## components/modules/utilities/rgb_led_indicator/Kconfig
```kconfig
menu "Rgb_Led_Indicator Module Configuration"

    config MODULE_RGB_LED_INDICATOR_ENABLED
        bool "Enable Rgb_Led_Indicator Module"
        default y
        help
            Enables the rgb_led_indicator module for System LED indicator.
            When enabled, the module provides full functionality.
            If disabled, the module code will not be included in 
            the final firmware, saving memory and processing resources.

    config RGB_LED_INDICATOR_DEFAULT_INSTANCE_NAME
        string "Default Instance Name"
        default "main_rgb_led_indicator"
        depends on MODULE_RGB_LED_INDICATOR_ENABLED
        help
            Default instance name for the rgb_led_indicator module.

    config RGB_LED_INDICATOR_INSTANCE_NAME_MAX_LEN
        int "Maximum Instance Name Length"
        default 32
        range 8 64
        depends on MODULE_RGB_LED_INDICATOR_ENABLED
        help
            Maximum length for the rgb_led_indicator module instance name string.

    if MODULE_RGB_LED_INDICATOR_ENABLED
    
        config RGB_LED_INDICATOR_LEDC_TIMER
            int "LEDC Timer Number"
            default 0
            range 0 3
            depends on MODULE_RGB_LED_INDICATOR_ENABLED
            help
                Select the LEDC timer to use for PWM generation.
                Usually, TIMER_0 is a safe choice.

        config RGB_LED_INDICATOR_LEDC_CHANNEL_R
            int "LEDC Channel for RED"
            default 0
            range 0 7
            depends on MODULE_RGB_LED_INDICATOR_ENABLED
            help
                Select the LEDC channel for the RED color component.

        config RGB_LED_INDICATOR_LEDC_CHANNEL_G
            int "LEDC Channel for GREEN"
            default 1
            range 0 7
            depends on MODULE_RGB_LED_INDICATOR_ENABLED
            help
                Select the LEDC channel for the GREEN color component.

        config RGB_LED_INDICATOR_LEDC_CHANNEL_B
            int "LEDC Channel for BLUE"
            default 2
            range 0 7
            depends on MODULE_RGB_LED_INDICATOR_ENABLED
            help
                Select the LEDC channel for the BLUE color component.
    
    endif

endmenu
```

## components/modules/utilities/ui_manager/Kconfig
```kconfig
menu "UI Manager"

    config MODULE_UI_MANAGER_ENABLED
        bool "Enable UI Manager Module"
        default y
        help
            Enables the ui_manager module for Manages the user interface, including menus and status screens..

    config UI_MANAGER_DEFAULT_INSTANCE_NAME
        string "Default Instance Name"
        default "main_ui_manager"
        depends on MODULE_UI_MANAGER_ENABLED
        help
            Default instance name for the ui_manager module.

    config UI_MANAGER_INSTANCE_NAME_MAX_LEN
        int "Maximum Instance Name Length"
        default 32
        range 8 64
        depends on MODULE_UI_MANAGER_ENABLED
        help
            Maximum length for the ui_manager module instance name string.

endmenu
```
