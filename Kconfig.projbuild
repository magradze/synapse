## components/modules/displays/ssd1306_driver/Kconfig
```kconfig
menu "SSD1306 Driver"

    config MODULE_SSD1306_DRIVER_ENABLED
        bool "Enable SSD1306 Driver Module"
        default y
        help
            Enables the ssd1306_driver module for Provides a low-level driver for SSD1306 OLED displays..

    config SSD1306_DRIVER_DEFAULT_INSTANCE_NAME
        string "Default Instance Name"
        default "main_ssd1306_driver"
        depends on MODULE_SSD1306_DRIVER_ENABLED
        help
            Default instance name for the ssd1306_driver module.

    config SSD1306_DRIVER_INSTANCE_NAME_MAX_LEN
        int "Maximum Instance Name Length"
        default 32
        range 8 64
        depends on MODULE_SSD1306_DRIVER_ENABLED
        help
            Maximum length for the ssd1306_driver module instance name string.

endmenu
```

## components/modules/displays/ssd1306_oled_display/Kconfig
```kconfig
menu "SSD1306 OLED Display"

    config MODULE_SSD1306_OLED_DISPLAY_ENABLED
        bool "Enable SSD1306 OLED Display Module"
        default y
        help
            Enables the ssd1306_oled_display module for controlling I2C-based
            monochrome OLED screens. This module provides a service API and
            can display system status information.

    if MODULE_SSD1306_OLED_DISPLAY_ENABLED

    menu "Basic Configuration"
        help
            Basic operational parameters for the SSD1306 display module.

        config SSD1306_WIFI_STATUS_UPDATE_MS
            int "WiFi Status Update Interval (ms)"
            default 15000
            range 1000 60000
            help
                Specifies how often (in milliseconds) the display should request
                an update for the WiFi status icon (RSSI level). A shorter interval
                provides more real-time feedback but increases system load slightly.

    endmenu # Basic Configuration

    menu "Advanced Configuration (Expert)"
        help
            Advanced memory and resource settings. Change these only if you
            understand the impact on performance and memory usage.

        config SSD1306_LINE_BUFFER_SIZE
            int "Line Text Buffer Size (bytes)"
            default 32
            range 16 64
            help
                Sets the size of the internal buffer for text sent to the display
                via the API. If you need to display very long lines of text,
                you might need to increase this.

        config SSD1306_CMD_QUEUE_LENGTH
            int "Command Queue Length"
            default 5
            range 2 10
            help
                Sets the number of display commands (like 'write_text' or 'clear')
                that can be queued up before the API call might block. A larger
                queue can handle more rapid updates but uses more RAM.

    endmenu # Advanced Configuration

    endif # MODULE_SSD1306_OLED_DISPLAY_ENABLED

endmenu
```

## components/modules/drivers/button_input/Kconfig
```kconfig
menu "Button Input"

    config MODULE_BUTTON_INPUT_ENABLED
        bool "Enable Button Input Module"
        default y
        help
            Enables the button_input module for A module to handle hardware button presses and publish events..

    config BUTTON_INPUT_DEFAULT_INSTANCE_NAME
        string "Default Instance Name"
        default "main_button_input"
        depends on MODULE_BUTTON_INPUT_ENABLED
        help
            Default instance name for the button_input module.

    config BUTTON_INPUT_INSTANCE_NAME_MAX_LEN
        int "Maximum Instance Name Length"
        default 32
        range 8 64
        depends on MODULE_BUTTON_INPUT_ENABLED
        help
            Maximum length for the button_input module instance name string.

endmenu
```

## components/modules/drivers/i2c_bus/Kconfig
```kconfig
menu "I2C Bus"

    config MODULE_I2C_BUS_ENABLED
        bool "Enable I2C Bus Module"
        default y
        help
            Enables the i2c_bus module for A module for I2C Bus.

    config I2C_BUS_DEFAULT_INSTANCE_NAME
        string "Default Instance Name"
        default "main_i2c_bus"
        depends on MODULE_I2C_BUS_ENABLED
        help
            Default instance name for the i2c_bus module.

    config I2C_BUS_INSTANCE_NAME_MAX_LEN
        int "Maximum Instance Name Length"
        default 32
        range 8 64
        depends on MODULE_I2C_BUS_ENABLED
        help
            Maximum length for the i2c_bus module instance name string.

endmenu
```

## components/modules/drivers/mcp23017_io_expander/Kconfig
```kconfig
menu "MCP23017 IO Expander"

    config MODULE_MCP23017_IO_EXPANDER_ENABLED
        bool "Enable MCP23017 IO Expander Module"
        default y
        help
            Enables the mcp23017_io_expander module for A driver for the MCP23017 I2C 16-bit I/O expander..

    config MCP23017_IO_EXPANDER_DEFAULT_INSTANCE_NAME
        string "Default Instance Name"
        default "main_io_expander"
        depends on MODULE_MCP23017_IO_EXPANDER_ENABLED
        help
            Default instance name for the mcp23017_io_expander module.

    config MCP23017_IO_EXPANDER_INSTANCE_NAME_MAX_LEN
        int "Maximum Instance Name Length"
        default 32
        range 8 64
        depends on MODULE_MCP23017_IO_EXPANDER_ENABLED
        help
            Maximum length for the mcp23017_io_expander module instance name string.

endmenu
```

## components/modules/drivers/rotary_encoder_input/Kconfig
```kconfig
menu "Rotary Encoder Input"

    config MODULE_ROTARY_ENCODER_INPUT_ENABLED
        bool "Enable Rotary Encoder Input Module"
        default y
        help
            Enables the rotary_encoder_input module for handling rotary encoder inputs.

    config ROTARY_ENCODER_MAX_INSTANCES
        int "Maximum number of encoder instances"
        default 4
        range 1 16
        depends on MODULE_ROTARY_ENCODER_INPUT_ENABLED
        help
            Sets the maximum number of rotary encoder instances that can be
            configured and run simultaneously.

    config ROTARY_ENCODER_POLLING_MS
        int "Polling Interval (ms)"
        default 20
        range 5 100
        depends on MODULE_ROTARY_ENCODER_INPUT_ENABLED
        help
            Polling interval in milliseconds for reading the encoder state.
            A lower value provides faster response but increases CPU usage.

    config ROTARY_ENCODER_DEBOUNCE_MS
        int "Switch Debounce Time (ms)"
        default 50
        depends on MODULE_ROTARY_ENCODER_INPUT_ENABLED
        help
            Debounce time in milliseconds for the encoder's push button to prevent
            multiple triggers from a single press.

endmenu
```

## components/modules/drivers/sn74hc595n_writer/Kconfig
```kconfig
menu "SN74HC595N Writer"

    config MODULE_SN74HC595N_WRITER_ENABLED
        bool "Enable SN74HC595N Writer Module"
        default y
        help
            Enables the sn74hc595n_writer module for A driver module for the SN74HC595N shift register to expand output pins using SPI..

    config SN74HC595N_WRITER_DEFAULT_INSTANCE_NAME
        string "Default Instance Name"
        default "main_sn74hc595n_writer"
        depends on MODULE_SN74HC595N_WRITER_ENABLED
        help
            Default instance name for the sn74hc595n_writer module.

    config SN74HC595N_WRITER_INSTANCE_NAME_MAX_LEN
        int "Maximum Instance Name Length"
        default 32
        range 8 64
        depends on MODULE_SN74HC595N_WRITER_ENABLED
        help
            Maximum length for the sn74hc595n_writer module instance name string.

endmenu
```

## components/modules/drivers/spi_bus/Kconfig
```kconfig
menu "SPI Bus"

    config MODULE_SPI_BUS_ENABLED
        bool "Enable SPI Bus Module"
        default y
        help
            Enables the spi_bus module for A centralized, thread-safe driver for an SPI hardware bus..

    config SPI_BUS_DEFAULT_INSTANCE_NAME
        string "Default Instance Name"
        default "main_spi_bus"
        depends on MODULE_SPI_BUS_ENABLED
        help
            Default instance name for the spi_bus module.

    config SPI_BUS_INSTANCE_NAME_MAX_LEN
        int "Maximum Instance Name Length"
        default 32
        range 8 64
        depends on MODULE_SPI_BUS_ENABLED
        help
            Maximum length for the spi_bus module instance name string.

endmenu
```

## components/modules/provisioning/ble_provisioning/Kconfig
```kconfig
menu "BLE Provisioning"

    config MODULE_BLE_PROVISIONING_ENABLED
        bool "Enable BLE Provisioning module"
        default y
        help
            Enable or disable BLE Provisioning module at compile time

    config BLE_PROVISIONING_DEFAULT_INSTANCE_NAME
        string "Default Instance Name"
        default "main_ble_provisioning"
        depends on MODULE_BLE_PROVISIONING_ENABLED
        help
            Default instance name for the ble_provisioning module.

    config BLE_PROVISIONING_INSTANCE_NAME_MAX_LEN
        int "Maximum Instance Name Length"
        default 32
        range 8 64
        depends on MODULE_BLE_PROVISIONING_ENABLED
        help
            Maximum length for the ble_provisioning module instance name string.

    if MODULE_BLE_PROVISIONING_ENABLED

        config ESP_PROV_DEVICE_NAME
            string "BLE Device Name"
            default "Synapse-Prov"
            help
                Device name that will appear during BLE scanning

        config ESP_PROV_SECURITY_VERSION
            int "Security Version (0 or 1)"
            range 0 1
            default 1
            help
                Security version:
                0 - No security (for testing only)
                1 - Secure communication with POP

        config ESP_PROV_POP
            string "Proof of Possession (8 characters)"
            default "abcd1234"
            depends on ESP_PROV_SECURITY_VERSION = 1
            help
                8-character proof of possession string for secure provisioning

        config ESP_PROV_AUTO_STOP
            bool "Auto stop provisioning after WiFi connection"
            default y
            help
                Automatically stop provisioning service when WiFi connects

    endif # MODULE_BLE_PROVISIONING_ENABLED
endmenu
```

## components/modules/security/security_status_reporter/Kconfig
```kconfig
menu "Security Status Reporter"

    config MODULE_SECURITY_STATUS_REPORTER_ENABLED
        bool "Enable Security Status Reporter Module"
        default y
        help
            Enables the security_status_reporter module for Reports Secure Boot and Flash Encryption status..
            When enabled, the module provides full functionality.
            If disabled, the module code will not be included in 
            the final firmware, saving memory and processing resources.

    config SECURITY_STATUS_REPORTER_DEFAULT_INSTANCE_NAME
        string "Default Instance Name"
        default "main_security_status_reporter"
        depends on MODULE_SECURITY_STATUS_REPORTER_ENABLED
        help
            Default instance name for the security_status_reporter module.

    config SECURITY_STATUS_REPORTER_INSTANCE_NAME_MAX_LEN
        int "Maximum Instance Name Length"
        default 32
        range 8 64
        depends on MODULE_SECURITY_STATUS_REPORTER_ENABLED
        help
            Maximum length for the security_status_reporter module instance name string.

endmenu
```

## components/modules/sensors/sensor_aggregator/Kconfig
```kconfig
menu "Sensor Aggregator"

    config MODULE_SENSOR_AGGREGATOR_ENABLED
        bool "Enable Sensor Aggregator Module"
        default y
        help
            Enables the sensor_aggregator module for Aggregates data from multiple sensors into a single report..
            When enabled, the module provides full functionality.
            If disabled, the module code will not be included in 
            the final firmware, saving memory and processing resources.

    config SENSOR_AGGREGATOR_DEFAULT_INSTANCE_NAME
        string "Default Instance Name"
        default "main_sensor_aggregator"
        depends on MODULE_SENSOR_AGGREGATOR_ENABLED
        help
            Default instance name for the sensor_aggregator module.

    config SENSOR_AGGREGATOR_INSTANCE_NAME_MAX_LEN
        int "Maximum Instance Name Length"
        default 32
        range 8 64
        depends on MODULE_SENSOR_AGGREGATOR_ENABLED
        help
            Maximum length for the sensor_aggregator module instance name string.

    config SENSOR_AGGREGATOR_MAX_SENSORS
        int "Maximum sensors to aggregate"
        default 10
        depends on MODULE_SENSOR_AGGREGATOR_ENABLED
        help
            The maximum number of individual sensor events that the aggregator can listen for.

    config SENSOR_AGGREGATOR_EVENT_NAME_MAX_LEN
        int "Maximum length for sensor event names"
        default 48
        depends on MODULE_SENSOR_AGGREGATOR_ENABLED
        help
            The maximum buffer size for storing the names of events that the
            aggregator subscribes to.

    config SENSOR_AGGREGATOR_BUFFERING_ENABLED
        bool "Enable offline data buffering"
        default y
        depends on MODULE_SENSOR_AGGREGATOR_ENABLED
        help
            If enabled, the aggregator will cache reports to the filesystem
            when the device is offline and send them when connectivity is restored.
            Requires a filesystem backend (SPIFFS or SD Card) for Storage Manager.

    config SENSOR_AGGREGATOR_CACHE_DIR
        string "Cache directory for buffered reports"
        default "/spiffs/aggr_cache"
        depends on SENSOR_AGGREGATOR_BUFFERING_ENABLED
        help
            The directory path where offline reports will be stored.

    config SENSOR_AGGREGATOR_MAX_CACHED_FILES
        int "Maximum number of cached report files"
        default 50
        depends on SENSOR_AGGREGATOR_BUFFERING_ENABLED
        help
            The maximum number of report files to store offline. When the limit
            is reached, the oldest files may be deleted.

    config SENSOR_AGGREGATOR_PATH_BUFFER_SIZE
        int "File Path Buffer Size"
        default 128
        range 64 256
        depends on SENSOR_AGGREGATOR_BUFFERING_ENABLED
        help
            The buffer size in bytes for constructing file paths when reading
            or writing cached reports. Should be large enough for the cache
            directory path plus the longest possible filename.

    config SENSOR_AGGREGATOR_FILE_BUFFER_SIZE
        int "File Read Buffer Size"
        default 1024
        range 256 4096
        depends on SENSOR_AGGREGATOR_BUFFERING_ENABLED
        help
            The buffer size in bytes for reading a single cached report file
            from the filesystem. This value limits the maximum size of a
            single aggregated report that can be buffered.
endmenu
```

## components/modules/sensors/time_of_flight_sensor/Kconfig
```kconfig
menu "Time of Flight Sensor"

    config MODULE_TIME_OF_FLIGHT_SENSOR_ENABLED
        bool "Enable Time of Flight Sensor Module"
        default n
        help
            Enables the driver for I2C-based Time-of-Flight (TOF) distance sensors like VL53L0X.

    if MODULE_TIME_OF_FLIGHT_SENSOR_ENABLED

    config TOF_SENSOR_DEFAULT_INSTANCE_NAME
        string "Default Instance Name"
        default "main_tof_sensor"
        help
            Default instance name for the TOF sensor module.

    config TOF_SENSOR_DEFAULT_I2C_BUS
        string "Default I2C Bus Service Name"
        default "main_i2c_bus"
        help
            The instance_name of the i2c_bus service this sensor should use.

    config TOF_SENSOR_DEFAULT_UPDATE_INTERVAL
        int "Default Update Interval (seconds)"
        default 10
        help
            The default interval in seconds for reading sensor data.

    endif # MODULE_TIME_OF_FLIGHT_SENSOR_ENABLED
endmenu
```
