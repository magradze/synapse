## components/modules/utillities/system_timer/Kconfig
```kconfig
menu "System Timer"

    config MODULE_SYSTEM_TIMER_ENABLED
        bool "Enable System Timer Module"
        default y
        help
            Enables the system_timer module for A centralized service for scheduling events..
            When enabled, the module provides full functionality.
            If disabled, the module code will not be included in 
            the final firmware, saving memory and processing resources.

    if MODULE_SYSTEM_TIMER_ENABLED

        config SYSTEM_TIMER_DEFAULT_INSTANCE_NAME
            string "Default Instance Name"
            default "main_timer_service"
            depends on MODULE_SYSTEM_TIMER_ENABLED
            help
                Default instance name for the system_timer module.

        config SYSTEM_TIMER_INSTANCE_NAME_MAX_LEN
            int "Maximum Instance Name Length"
            default 32
            range 8 64
            depends on MODULE_SYSTEM_TIMER_ENABLED
            help
                Maximum length for the system_timer module instance name string.

        config SYSTEM_TIMER_MAX_TIMERS
            int "Maximum number of concurrent timers"
            default 16
            range 4 64
            help
                Sets the maximum number of timers that can be scheduled simultaneously.
                Each scheduled event consumes one timer slot.

    endif # MODULE_SYSTEM_TIMER_ENABLED

endmenu
```
